## main/Kconfig.projbuild
```kconfig
# TODO: Remove all mentions of example
menu "Example Configuration"

    config WIFI_SSID
        string "WiFi SSID"
        default "myssid"
        help
            SSID (network name) for the example to connect to.

    config WIFI_PASSWORD
        string "WiFi Password"
        default "mypassword"
        help
            WiFi password (WPA or WPA2) for the example to use.

    config GPIO_INPUT_PIN
        int "GPIO input pin"
        # TODO: Proper range validation
        range 0 48
        default 4
        help
            GPIO pin number to be used to read from button
            WARNING: There is no validation of the port range. Different boards may have a different number of pins

    config WEBHOOK_SERVER
        string "Webhook server"
        default "example.com"
        help
            IP or hostname of the server accepting the HTTP webhooks

    config WEBHOOK_PORT
        string "Webhook port"
        default "8080"
        help
            Port that the "webhook server" is listening on

    config WEBHOOK_ID
        string "Webhook ID"
        default "supersecret"
        help
            The (secret) webhook ID. Webhooks will be sent to the path "/webhook/WEBHOOK_ID"

    config WEBHOOK_BUTTON_ID
        int "Webhook button ID"
        range 1 9
        default 1
        help
            The button ID to send in the webhook request data

endmenu
```
